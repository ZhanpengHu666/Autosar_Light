AUTOSAR XML (schema 4-0-3)
package /DaVinci_Project
  module config Com
    ComConfig
      12 x ComSignal:
        EmergencyBrakeLight_omsg_Receive_oCAN00_5282eb8e_Rx: ComSignalType=UINT8
        HazardSw_omsg_Receive_oCAN00_578d9c4d_Rx: ComSignalType=UINT8
        IGN_Status_omsg_Receive_oCAN00_593fdbd9_Rx: ComSignalType=UINT8
        LA_St_DirectionLampL_omsg_Transmit_oCAN00_c218ca04_Tx: ComSignalType=UINT8
        LA_St_DirectionLampR_omsg_Transmit_oCAN00_a05dfcc5_Tx: ComSignalType=UINT8
        TurnLampFb_FL_omsg_Receive_oCAN00_3ab29a6d_Rx: ComSignalType=UINT8
        TurnLampFb_FR_omsg_Receive_oCAN00_a2998431_Rx: ComSignalType=UINT8
        TurnLampFb_RL_omsg_Receive_oCAN00_cfe4432c_Rx: ComSignalType=UINT8
        TurnLampFb_RR_omsg_Receive_oCAN00_57cf5d70_Rx: ComSignalType=UINT8
        TurnLampSw_omsg_Receive_oCAN00_92b10255_Rx: ComSignalType=UINT8
        VehicleSpeed_Valid_omsg_Receive_oCAN00_6a5f4ba3_Rx: ComSignalType=UINT8
        VehicleSpeed_omsg_Receive_oCAN00_e95dd8a1_Rx: ComSignalType=UINT16
  module config Rte
    16 x RteBswModuleInstance:
      BswM
        BswM_MainFunctionTimingEvent0 (RteBswEventToTaskMapping): RteBswUsedOsEventRef=Rte_Ev_Cyclic2_OsTask_BSW_SCHM_0_10ms, RteBswUsedOsAlarmRef=Os/Rte_Al_TE2_OsTask_BSW_SCHM_0_10ms
      Can
        3 x RteBswEventToTaskMapping, all with RteBswUsedOsEventRef=Rte_Ev_Cyclic2_OsTask_BSW_SCHM_0_10ms, RteBswUsedOsAlarmRef=Os/Rte_Al_TE2_OsTask_BSW_SCHM_0_10ms:
          Can_MainFunction_BusOffTimingEvent0
          Can_MainFunction_ModeTimingEvent0
          Can_MainFunction_WakeupTimingEvent0
      CanIf
      CanSM
        CanSM_MainFunctionTimingEvent0 (RteBswEventToTaskMapping): RteBswUsedOsEventRef=Rte_Ev_Cyclic2_OsTask_BSW_SCHM_0_10ms, RteBswUsedOsAlarmRef=Os/Rte_Al_TE2_OsTask_BSW_SCHM_0_10ms
      CanTp
        CanTp_MainFunctionTimingEvent0 (RteBswEventToTaskMapping): RteBswUsedOsEventRef=Rte_Ev_Run_CanTp_CanTp_MainFunction, RteBswUsedOsAlarmRef=Os/Rte_Al_TE_CanTp_CanTp_MainFunction
      Com
        Com_MainFunctionRxTimingEvent0 (RteBswEventToTaskMapping): RteBswUsedOsEventRef=Rte_Ev_Cyclic2_OsTask_BSW_SCHM_0_10ms, RteBswUsedOsAlarmRef=Os/Rte_Al_TE2_OsTask_BSW_SCHM_0_10ms
        Com_MainFunctionTxTimingEvent0 (RteBswEventToTaskMapping): RteBswUsedOsEventRef=Rte_Ev_Cyclic2_OsTask_BSW_SCHM_0_10ms, RteBswUsedOsAlarmRef=Os/Rte_Al_TE2_OsTask_BSW_SCHM_0_10ms
      ComM
        ComM_MainFunction_0TimingEvent0 (RteBswEventToTaskMapping): RteBswUsedOsEventRef=Rte_Ev_Cyclic2_OsTask_BSW_SCHM_0_20ms, RteBswUsedOsAlarmRef=Os/Rte_Al_TE2_OsTask_BSW_SCHM_0_20ms
      Dcm
        Dcm_MainFunctionTimingEvent0 (RteBswEventToTaskMapping): RteBswUsedOsEventRef=Rte_Ev_Cyclic2_OsTask_BSW_SCHM_0_10ms, RteBswUsedOsAlarmRef=Os/Rte_Al_TE2_OsTask_BSW_SCHM_0_10ms
      Dem
        Dem_MasterMainFunctionTimingEvent0 (RteBswEventToTaskMapping): RteBswUsedOsEventRef=Rte_Ev_Cyclic2_OsTask_BSW_SCHM_0_10ms, RteBswUsedOsAlarmRef=Os/Rte_Al_TE2_OsTask_BSW_SCHM_0_10ms
        Dem_SatelliteMainFunctionTimingEvent0 (RteBswEventToTaskMapping): RteBswUsedOsEventRef=Rte_Ev_Cyclic2_OsTask_BSW_SCHM_0_10ms, RteBswUsedOsAlarmRef=Os/Rte_Al_TE2_OsTask_BSW_SCHM_0_10ms
      Det
      Dio
      EcuM
        EcuM_MainFunctionTimingEvent0 (RteBswEventToTaskMapping): RteBswUsedOsEventRef=Rte_Ev_Cyclic2_OsTask_BSW_SCHM_0_10ms, RteBswUsedOsAlarmRef=Os/Rte_Al_TE2_OsTask_BSW_SCHM_0_10ms
      Mcu
      PduR
      Port
      Spi
        Spi_MainFunction_HandlingTimingEvent0 (RteBswEventToTaskMapping)
    14 x RteSwComponentInstance:
      BswM_EcuSwComposition
        Timer_BswM_MainFunction (RteEventToTaskMapping): RteUsedOsEventRef=Rte_Ev_Cyclic2_OsTask_BSW_SCHM_0_10ms, RteUsedOsAlarmRef=Os/Rte_Al_TE2_OsTask_BSW_SCHM_0_10ms
      CddIoHwAb_EcuSwComposition
        TMT_IoHwAbRunnable (RteEventToTaskMapping): RteUsedOsEventRef=Rte_Ev_Cyclic_OsTask_BSW_SCHM_0_10ms, RteUsedOsAlarmRef=Os/Rte_Al_TE_OsTask_BSW_SCHM_0_10ms
      Cdd_SBC_UJA1169_EcuSwComposition
        TMT_Sbc_Test_Runnable (RteEventToTaskMapping): RteUsedOsEventRef=Rte_Ev_Run_Cdd_SBC_UJA1169_Sbc_Test_Runnable, RteUsedOsAlarmRef=Os/Rte_Al_TE_Cdd_SBC_UJA1169_Sbc_Test_Runnable
      ComM_EcuSwComposition
        Timer_ComM_MainFunction_0 (RteEventToTaskMapping): RteUsedOsEventRef=Rte_Ev_Cyclic2_OsTask_BSW_SCHM_0_20ms, RteUsedOsAlarmRef=Os/Rte_Al_TE2_OsTask_BSW_SCHM_0_20ms
      CpLedTask_EcuSwComposition
        TMT_LedRunnable (RteEventToTaskMapping): RteUsedOsEventRef=Rte_Ev_Run_CpLedTask_LedRunnable, RteUsedOsAlarmRef=Os/Rte_Al_TE_CpLedTask_LedRunnable
      Dcm_EcuSwComposition
        Timer_Dcm_MainFunction (RteEventToTaskMapping): RteUsedOsEventRef=Rte_Ev_Cyclic2_OsTask_BSW_SCHM_0_10ms, RteUsedOsAlarmRef=Os/Rte_Al_TE2_OsTask_BSW_SCHM_0_10ms
      DemMaster_0_EcuSwComposition
        Timer_Dem_MasterMainFunction (RteEventToTaskMapping): RteUsedOsEventRef=Rte_Ev_Cyclic2_OsTask_BSW_SCHM_0_10ms, RteUsedOsAlarmRef=Os/Rte_Al_TE2_OsTask_BSW_SCHM_0_10ms
      DemSatellite_0_EcuSwComposition
        Timer_Dem_SatelliteMainFunction (RteEventToTaskMapping): RteUsedOsEventRef=Rte_Ev_Cyclic2_OsTask_BSW_SCHM_0_10ms, RteUsedOsAlarmRef=Os/Rte_Al_TE2_OsTask_BSW_SCHM_0_10ms
      Det_EcuSwComposition
      EcuM_EcuSwComposition
        Timer_EcuM_MainFunction (RteEventToTaskMapping): RteUsedOsEventRef=Rte_Ev_Cyclic2_OsTask_BSW_SCHM_0_10ms, RteUsedOsAlarmRef=Os/Rte_Al_TE2_OsTask_BSW_SCHM_0_10ms
      Os_OsCore0_swc_EcuSwComposition
      TurnLight_EcuSwComposition
        TMT_TurnLight_Runnable_10ms (RteEventToTaskMapping): RteUsedOsEventRef=Rte_Ev_Cyclic_OsTask_BSW_SCHM_0_10ms, RteUsedOsAlarmRef=Os/Rte_Al_TE_OsTask_BSW_SCHM_0_10ms
      TurnLightAct_EcuSwComposition
        TMT_Runnable_10ms (RteEventToTaskMapping): RteUsedOsEventRef=Rte_Ev_Cyclic_OsTask_BSW_SCHM_0_10ms, RteUsedOsAlarmRef=Os/Rte_Al_TE_OsTask_BSW_SCHM_0_10ms
      TurnLightArb_EcuSwComposition
        TMT_TurnLightArb_Runnable_10ms (RteEventToTaskMapping): RteUsedOsEventRef=Rte_Ev_Cyclic_OsTask_BSW_SCHM_0_10ms, RteUsedOsAlarmRef=Os/Rte_Al_TE_OsTask_BSW_SCHM_0_10ms
    RteOsInteraction
      6 x RteUsedOsActivation, all with RteExpectedActivationOffset=0:
        Rte_Al_TE_Cdd_SBC_UJA1169_Sbc_Test_Runnable: RteActivationOsAlarmRef=Os/Rte_Al_TE_Cdd_SBC_UJA1169_Sbc_Test_Runnable, RteActivationOsTaskRef=OsTask_APP
        Rte_Al_TE_CpLedTask_LedRunnable: RteActivationOsAlarmRef=Os/Rte_Al_TE_CpLedTask_LedRunnable, RteActivationOsTaskRef=OsTask_APP
        Rte_Al_TE2_OsTask_BSW_SCHM_0_10ms: RteActivationOsAlarmRef=Os/Rte_Al_TE2_OsTask_BSW_SCHM_0_10ms, RteActivationOsTaskRef=OsTask_BSW_SCHM
        Rte_Al_TE2_OsTask_BSW_SCHM_0_20ms: RteActivationOsAlarmRef=Os/Rte_Al_TE2_OsTask_BSW_SCHM_0_20ms, RteActivationOsTaskRef=OsTask_BSW_SCHM
        Rte_Al_TE_CanTp_CanTp_MainFunction: RteActivationOsAlarmRef=Os/Rte_Al_TE_CanTp_CanTp_MainFunction, RteActivationOsTaskRef=OsTask_BSW_SCHM
        Rte_Al_TE_OsTask_BSW_SCHM_0_10ms: RteActivationOsAlarmRef=Os/Rte_Al_TE_OsTask_BSW_SCHM_0_10ms, RteActivationOsTaskRef=OsTask_BSW_SCHM
  module config NvM
  module config Os
    OsTask_APP (OsTask):
      OsTaskActivation = 1
      OsTaskPriority = 15
      OsTaskSchedule = NON
      OsTaskEventRef = Rte_Ev_Run_Cdd_SBC_UJA1169_Sbc_Test_Runnable
      OsTaskEventRef = Rte_Ev_Run_CpLedTask_LedRunnable
    Rte_Al_TE_Cdd_SBC_UJA1169_Sbc_Test_Runnable (OsAlarm): OsAlarmCounterRef=SystemTimer
      OsAlarmAction
        OsAlarmSetEvent: OsAlarmSetEventRef=Rte_Ev_Run_Cdd_SBC_UJA1169_Sbc_Test_Runnable, OsAlarmSetEventTaskRef=OsTask_APP
    Rte_Al_TE_CpLedTask_LedRunnable (OsAlarm): OsAlarmCounterRef=SystemTimer
      OsAlarmAction
        OsAlarmSetEvent: OsAlarmSetEventRef=Rte_Ev_Run_CpLedTask_LedRunnable, OsAlarmSetEventTaskRef=OsTask_APP
    OsTask_BSW_SCHM (OsTask):
      OsTaskActivation = 1
      OsTaskPriority = 10
      OsTaskSchedule = NON
      OsTaskEventRef = Rte_Ev_Cyclic2_OsTask_BSW_SCHM_0_10ms
      OsTaskEventRef = Rte_Ev_Cyclic2_OsTask_BSW_SCHM_0_20ms
      OsTaskEventRef = Rte_Ev_Cyclic_OsTask_BSW_SCHM_0_10ms
      OsTaskEventRef = Rte_Ev_Run_CanTp_CanTp_MainFunction
    4 x OsAlarm, all with OsAlarmCounterRef=SystemTimer:
      Rte_Al_TE2_OsTask_BSW_SCHM_0_10ms
        OsAlarmAction
          OsAlarmSetEvent: OsAlarmSetEventRef=Rte_Ev_Cyclic2_OsTask_BSW_SCHM_0_10ms, OsAlarmSetEventTaskRef=OsTask_BSW_SCHM
      Rte_Al_TE2_OsTask_BSW_SCHM_0_20ms
        OsAlarmAction
          OsAlarmSetEvent: OsAlarmSetEventRef=Rte_Ev_Cyclic2_OsTask_BSW_SCHM_0_20ms, OsAlarmSetEventTaskRef=OsTask_BSW_SCHM
      Rte_Al_TE_CanTp_CanTp_MainFunction
        OsAlarmAction
          OsAlarmSetEvent: OsAlarmSetEventRef=Rte_Ev_Run_CanTp_CanTp_MainFunction, OsAlarmSetEventTaskRef=OsTask_BSW_SCHM
      Rte_Al_TE_OsTask_BSW_SCHM_0_10ms
        OsAlarmAction
          OsAlarmSetEvent: OsAlarmSetEventRef=Rte_Ev_Cyclic_OsTask_BSW_SCHM_0_10ms, OsAlarmSetEventTaskRef=OsTask_BSW_SCHM
    6 x OsEvent:
      Rte_Ev_Cyclic2_OsTask_BSW_SCHM_0_10ms
      Rte_Ev_Cyclic2_OsTask_BSW_SCHM_0_20ms
      Rte_Ev_Cyclic_OsTask_BSW_SCHM_0_10ms
      Rte_Ev_Run_CanTp_CanTp_MainFunction
      Rte_Ev_Run_Cdd_SBC_UJA1169_Sbc_Test_Runnable
      Rte_Ev_Run_CpLedTask_LedRunnable
  module config EcuC
  ecuc value collection DaVinci_Project: ecuc-values=[Com, Rte, Os, EcuC, NvM]

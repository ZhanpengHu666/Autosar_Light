AUTOSAR XML (schema 00044)
package /ComponentTypes
  complex device driver sw component type CddSbc
    behavior CddSbc_InternalBehavior
      timing event TMT_Sbc_Test_Runnable: start-on-event=Sbc_Test_Runnable, period=0.1
      runnable Sbc_Test_Runnable
  swc implementation CddSbc_Implementation: behavior=CddSbc_InternalBehavior

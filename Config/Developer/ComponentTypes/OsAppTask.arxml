AUTOSAR XML (schema 00044)
package /ComponentTypes
  application sw component type OsAppTask
    behavior OsAppTask_InternalBehavior
      timing event TMT_Runnable: start-on-event=Runnable_AppTask, period=0.1
      runnable Runnable_AppTask
  swc implementation OsAppTask_Implementation: behavior=OsAppTask_InternalBehavior

AUTOSAR XML (schema 00044)
standard types defined: boolean, uint8
package /Predefined_DEV/ImplementationDataTypes
  impl type NvM_RequestResultType: compu {0=NVM_REQ_OK, 1=NVM_REQ_NOT_OK, 2=NVM_REQ_PENDING, 3=NVM_REQ_INTEGRITY_FAILED, 4=NVM_REQ_BLOCK_SKIPPED, 5=NVM_REQ_NV_INVALIDATED, 6=NVM_REQ_CANCELED, 7=NVM_REQ_REDUNDANCY_FAILED, 8=NVM_REQ_RESTORED_FROM_ROM}, implementation-data-type=uint8
  impl type NvM_ServiceIdType: compu {6=NVM_READ_BLOCK, 7=NVM_WRITE_BLOCK, 8=NVM_RESTORE_BLOCK_DEFAULTS, 9=NVM_ERASE_BLOCK, 11=NVM_INVALIDATE_NV_BLOCK, 12=NVM_READ_ALL}, implementation-data-type=uint8
  impl type Dem_UdsStatusByteType: compu {mask 1: 1=DEM_UDS_STATUS_TF, mask 2: 2=DEM_UDS_STATUS_TFTOC, mask 4: 4=DEM_UDS_STATUS_PDTC, mask 8: 8=DEM_UDS_STATUS_CDTC, mask 16: 16=DEM_UDS_STATUS_TNCSLC, mask 32: 32=DEM_UDS_STATUS_TFSLC, mask 64: 64=DEM_UDS_STATUS_TNCTOC, mask 128: 128=DEM_UDS_STATUS_WIR}, range raw 0..255, implementation-data-type=uint8
package /DataType/Constraint
  range DC_sig_LampCnt: raw 0..255
  range DC_sig_RearInteriorLight: raw 0..1
  range DC_sig_State_RearInteriorLight: raw 0..1
  range DC_sig_State_RearLeftDoor: raw 0..1
  range DC_sig_State_RearRightDoor: raw 0..1
package /DataTypes
  impl type ComplexTurnLightONOFFType: compu {0=NORQUEST, 1=OFF, 2=ON}, implementation-data-type=uint8, type-emitter=RTE
  impl type ComplexTurnLightPositionType: compu-method=ComplexTurnLightPosition, implementation-data-type=uint8, type-emitter=RTE
  impl type TurnLightService: category=STRUCTURE, sw-calibration-access=READ-ONLY, type-emitter=RTE
    7 x element, all with category=TYPE_REFERENCE:
      TurnLightPosition: compu-method=ComplexTurnLightPosition, implementation-data-type=ComplexTurnLightPositionType
      TurnLightOnOff: compu {0=NORQUEST, 1=OFF, 2=ON}, implementation-data-type=ComplexTurnLightONOFFType
      TurnLightDutyCycle: implementation-data-type=uint8, invalid-value=0
      TurnLightCycle: implementation-data-type=uint8, invalid-value=0
      TurnLightTimes: implementation-data-type=uint8, invalid-value=0
      TurnLightNumber: implementation-data-type=uint8, invalid-value=0
      TurnLightPriority: implementation-data-type=uint8, invalid-value=0
package /DataTypes/CompuMethods
  compu method ComplexTurnLightPosition: 0=NOREQUEST, 1=LEFT, 2=RIGHT, 3=ALL, 4=FRONT_LEFT, 5=MIDDLE_LEFT, 6=REAR_LEFT, 7=FRONT_RIGHT, 8=MIDDLE_RIGHT, 9=REAR_RIGHT

AUTOSAR XML (schema 00044)
package /VehicleProject
  system System
    root-software-compositions:
      root sw composition prototype EcuSwComposition: software-composition=ECU_Composition
package /ECUCompositionTypes
  composition sw component type ECU_Composition
    6 x component:
      CpLedTask: type=CtLedTask
      Cdd_SBC_UJA1169: type=CddSbc
      TurnLight: type=TurnLight
      TurnLightArb: type=TurnLightArb
      TurnLightAct: type=TurnLightAct
      CddIoHwAb: type=Cdd_IoHwAb
    connect TurnLightAct.TurnLampCtrlCmd_FR -> TurnLight.TurnLampCtrlCmd_FR
    connect TurnLightAct.TurnLampCtrlCmd_RR -> TurnLight.TurnLampCtrlCmd_RR
    connect TurnLightAct.CountSignal_Left -> TurnLight.CountSignal_Left
    connect TurnLightAct.TurnLampCtrlCmd_FL -> TurnLight.TurnLampCtrlCmd_FL
    connect TurnLightArb.TurnLightService -> TurnLight.TurnLightService
    connect TurnLightArb.TurnLamp_RL_Out -> TurnLightAct.TurnLamp_RL_Out
    connect TurnLightArb.TurnLapme_RR_Out -> TurnLightAct.TurnLapme_RR_Out
    connect TurnLightArb.TurnLamp_FL_Out -> TurnLightAct.TurnLamp_FL_Out
    connect TurnLightArb.TurnLapm_FR_Out -> TurnLightAct.TurnLapm_FR_Out
    connect TurnLightAct.TurnLampCtrlCmd_RL -> TurnLight.TurnLampCtrlCmd_RL
    connect TurnLightAct.CountSignal_Right -> TurnLight.CountSignal_Right
    connect CddIoHwAb.IoHwAb_TurnLightCtrlCmd_RR -> TurnLightAct.IoHwAb_TurnLightCtrlCmd_RR
    connect CddIoHwAb.IoHwAb_TurnLightCtrlCmd_FL -> TurnLightAct.IoHwAb_TurnLightCtrlCmd_FL
    connect CddIoHwAb.IoHwAb_TurnLightCtrlCmd_FR -> TurnLightAct.IoHwAb_TurnLightCtrlCmd_FR
    connect CddIoHwAb.IoHwAb_TurnLightCtrlCmd_RL -> TurnLightAct.IoHwAb_TurnLightCtrlCmd_RL
package /EndToEndProtections
  end to end protection set EndToEndProtectionSet

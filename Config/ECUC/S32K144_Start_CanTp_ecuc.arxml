AUTOSAR XML (schema 4-2-1)
package /ActiveEcuC
  module config CanTp: implementation-config-variant=VARIANT-PRE-COMPILE, module-description=CanTp_Impl
    CanTpGeneral:
      CanTpChangeParameterApi = false
      CanTpDevErrorDetect = true
      CanTpPaddingByte = 204
      CanTpReadParameterApi = false
      CanTpVersionInfoApi = false
      CanTpPaddingActive = true
      CanTpHavePaddingByte = false
      CanTpNumRxChannels = 0
      CanTpNumTxChannels = 0
      CanTpEnableSplitMainFunction = false
      CanTpSupportStandardAddressing = true
      CanTpSupportExtendedAddressing = true
      CanTpSupportMixed11Addressing = true
      CanTpOnlyNotifyInformedAppl = true
      CanTpRc = false
      CanTpTc = false
      CanTpSafeBswChecks = false
      CanTpEnableConstantBS = true
      CanTpEnableTransmitQueue = false
      CanTpUseOnlyFirstFc = true
    CanTpConfig: CanTpMainFunctionPeriod=0.005
      TPCH_e391c48f (CanTpChannel): CanTpChannelMode=CANTP_MODE_FULL_DUPLEX
        CanTpRxNSdu_85e31bc0 (CanTpRxNSdu):
          CanTpRxAddressingFormat = CANTP_STANDARD
          CanTpRxDl = 8
          CanTpRxTaType = CANTP_PHYSICAL
          CanTpNbr = 0.1
          CanTpRxNSduId = 0
          CanTpRxPaddingActivation = CANTP_ON
          CanTpBs = 8
          CanTpNar = 0.1
          CanTpNcr = 0.5
          CanTpRxWftMax = 15
          CanTpSTmin = 0.02
          CanTpRxNSduRef = msg_diag_Request_MyECU_oCAN00_a823f7ba_Rx
          CanTpTxFcNPdu_7fe257d9 (CanTpTxFcNPdu): CanTpTxFcNPduConfirmationPduId=0, CanTpTxFcNPduRef=msg_diag_Response_MyECU_Tp_oCAN00_0ed9d144_Tx
          CanTpRxNPdu_7fe257d9 (CanTpRxNPdu): CanTpRxNPduId=0, CanTpRxNPduRef=msg_diag_Request_MyECU_Tp_oCAN00_ecbacca2_Rx
        CanTpTxNSdu_85e31bc0 (CanTpTxNSdu):
          CanTpTxAddressingFormat = CANTP_STANDARD
          CanTpTxDl = 8
          CanTpTxTaType = CANTP_PHYSICAL
          CanTpNas = 0.1
          CanTpNcs = 0.2
          CanTpTc = false
          CanTpTxNSduId = 0
          CanTpTxPaddingActivation = CANTP_ON
          CanTpNbs = 0.5
          CanTpTxNSduRef = msg_diag_Response_MyECU_oCAN00_45311294_Tx
          CanTpTxNPdu_5d18832b (CanTpTxNPdu): CanTpTxNPduConfirmationPduId=0, CanTpTxNPduRef=msg_diag_Response_MyECU_Tp_oCAN00_0ed9d144_Tx
          CanTpRxFcNPdu_5d18832b (CanTpRxFcNPdu): CanTpRxFcNPduId=0, CanTpRxFcNPduRef=msg_diag_Request_MyECU_Tp_oCAN00_ecbacca2_Rx
      TPCH_3983176e (CanTpChannel): CanTpChannelMode=CANTP_MODE_FULL_DUPLEX
        CanTpRxNSdu_678e3b4e (CanTpRxNSdu):
          CanTpRxAddressingFormat = CANTP_STANDARD
          CanTpRxDl = 8
          CanTpRxTaType = CANTP_FUNCTIONAL
          CanTpNbr = 0.1
          CanTpRxNSduId = 1
          CanTpRxPaddingActivation = CANTP_ON
          CanTpRxNSduRef = msg_diag_RequestGlobal_oCAN00_38f4a687_Rx
          CanTpRxNPdu_55155daa (CanTpRxNPdu): CanTpRxNPduId=1, CanTpRxNPduRef=msg_diag_RequestGlobal_Tp_oCAN00_7b1e9193_Rx

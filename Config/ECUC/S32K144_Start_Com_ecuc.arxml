AUTOSAR XML (schema 4-2-1)
package /ActiveEcuC
  module config Com: implementation-config-variant=VARIANT-PRE-COMPILE, module-description=Com_Impl
    ComGeneration:
      ComOutOfBoundsWriteProtectionStrategy = NONE
      ComOutOfBoundsWriteSanitizer = false
      ComOutOfBoundsReadSanitizer = false
      ComReduceConstantData2Define = false
      ComBoolDataInArrayOfStructStrategy = BOOLEAN
      ComDeduplicateIndirectedData = true
      ComDataDeduplicationStrategy = WITH_CAST
      ComReduceBoolDataByNegationThreshold = 2
      ComReduceBoolDataByNumericalComparisonThreshold = 2
      ComReduceBoolDataByNumericalRelationThreshold = 2
      ComReduceBoolDataByNumericalOperandStrategy = WITH_ANY_VALUE
      ComReduceNumericalDataByOffsetThreshold = 2
      ComReduceNumericalDataByArraySubtractionThreshold = 2
      ComReduceDataByStreaming = false
      ComShortSymbols = false
      ComInterfacesForDeactivatedData = false
      ComReferringKeysInComments = false
    ComOptimization:
      ComTxCyclicProcessingISRLockThreshold = 1
      ComTxDeadlineMonitoringISRLockThreshold = 1
      ComTxProcessingISRLockThreshold = 1
      ComRxDeadlineMonitoringISRLockThreshold = 1
      ComRxDeferredProcessingISRLockThreshold = 1
      ComGatewayProcessingISRLockThreshold = 1
      ComGatewayDescriptionProcessingISRLockThreshold = 1
      ComIPduGroupISRLockThreshold = 1
    ComConfig: ComConfigurationId=0, ComRxDeferredNotificationCacheSize=0, ComRxImmediateNotificationCacheSize=0
      MyECU_oCAN00_Rx_4cbf71f7 (ComIPduGroup): ComIPduGroupHandleId=0
      sig_State_RearLeftDoor_omsg_Receive_oCAN00_84ad4140_Rx (ComSignal):
        ComBitPosition = 0
        ComBitSize = 1
        ComSignalEndianness = LITTLE_ENDIAN
        ComSignalInitValue = 0
        ComSignalType = BOOLEAN
        ComTimeout = 0
        ComSignalAccess = ACCESS_UNCLEAR
        ComHandleId = 12
        ComSystemTemplateSystemSignalRef = sig_State_RearLeftDoor
      sig_LampCnt_omsg_MyECU_Lamp_oCAN00_f37e68ea_Tx (ComSignal):
        ComBitPosition = 7
        ComBitSize = 8
        ComSignalEndianness = BIG_ENDIAN
        ComSignalInitValue = 0
        ComSignalType = UINT8
        ComTransferProperty = PENDING
        ComSignalAccess = ACCESS_UNCLEAR
        ComHandleId = 2
        ComSystemTemplateSystemSignalRef = sig_LampCnt
      ComTimeBase: ComRxTimeBase=0.01, ComTxTimeBase=0.01, ComGwTimeBase=0.01
      msg_Transmit_oCAN00_0723e95e_Tx (ComIPdu):
        ComIPduDirection = SEND
        ComIPduType = NORMAL
        ComIPduHandleId = 1
        ComIPduSignalProcessing = DEFERRED
        ComIPduCancellationSupport = false
        ComIPduGroupRef = MyECU_oCAN00_Tx_1ae5d671
        ComIPduSignalRef = LA_St_DirectionLampL_omsg_Transmit_oCAN00_c218ca04_Tx
        ComIPduSignalRef = LA_St_DirectionLampR_omsg_Transmit_oCAN00_a05dfcc5_Tx
        ComIPduSignalRef = sig_RearInteriorLight_omsg_Transmit_oCAN00_49a633c1_Tx
        ComPduIdRef = msg_Transmit_oCAN00_0723e95e_Tx
        ComTxIPdu: ComMinimumDelayTime=0, ComTxIPduUnusedAreasDefault=0
          ComTxModeTrue
            ComTxMode: ComTxModeMode=PERIODIC, ComTxModeTimeOffset=0, ComTxModeTimePeriod=0.1
          ComTxModeFalse
            ComTxMode: ComTxModeMode=PERIODIC, ComTxModeTimeOffset=0, ComTxModeTimePeriod=0.1
      sig_State_RearInteriorLight_omsg_Receive_oCAN00_63323183_Rx (ComSignal):
        ComBitPosition = 2
        ComBitSize = 1
        ComSignalEndianness = LITTLE_ENDIAN
        ComSignalInitValue = 0
        ComSignalType = BOOLEAN
        ComTimeout = 0
        ComSignalAccess = ACCESS_UNCLEAR
        ComHandleId = 11
        ComSystemTemplateSystemSignalRef = sig_State_RearInteriorLight
      sig_State_RearRightDoor_omsg_Receive_oCAN00_a8945098_Rx (ComSignal):
        ComBitPosition = 1
        ComBitSize = 1
        ComSignalEndianness = LITTLE_ENDIAN
        ComSignalInitValue = 0
        ComSignalType = BOOLEAN
        ComTimeout = 0
        ComSignalAccess = ACCESS_UNCLEAR
        ComHandleId = 13
        ComSystemTemplateSystemSignalRef = sig_State_RearRightDoor
      msg_Receive_oCAN00_2b456e3f_Rx (ComIPdu):
        ComIPduDirection = RECEIVE
        ComIPduType = NORMAL
        ComIPduHandleId = 0
        ComIPduSignalProcessing = DEFERRED
        ComIPduCancellationSupport = false
        ComIPduGroupRef = MyECU_oCAN00_Rx_4cbf71f7
        ComIPduSignalRef = CrashIntensity_omsg_Receive_oCAN00_57f27485_Rx
        ComIPduSignalRef = EmergencyBrakeLight_omsg_Receive_oCAN00_5282eb8e_Rx
        ComIPduSignalRef = HazardSw_omsg_Receive_oCAN00_578d9c4d_Rx
        ComIPduSignalRef = IGN_Status_omsg_Receive_oCAN00_593fdbd9_Rx
        ComIPduSignalRef = TurnLampFb_FL_omsg_Receive_oCAN00_3ab29a6d_Rx
        ComIPduSignalRef = TurnLampFb_FR_omsg_Receive_oCAN00_a2998431_Rx
        ComIPduSignalRef = TurnLampFb_RL_omsg_Receive_oCAN00_cfe4432c_Rx
        ComIPduSignalRef = TurnLampFb_RR_omsg_Receive_oCAN00_57cf5d70_Rx
        ComIPduSignalRef = TurnLampSw_omsg_Receive_oCAN00_92b10255_Rx
        ComIPduSignalRef = VehicleSpeed_Valid_omsg_Receive_oCAN00_6a5f4ba3_Rx
        ComIPduSignalRef = VehicleSpeed_omsg_Receive_oCAN00_e95dd8a1_Rx
        ComIPduSignalRef = sig_State_RearInteriorLight_omsg_Receive_oCAN00_63323183_Rx
        ComIPduSignalRef = sig_State_RearLeftDoor_omsg_Receive_oCAN00_84ad4140_Rx
        ComIPduSignalRef = sig_State_RearRightDoor_omsg_Receive_oCAN00_a8945098_Rx
        ComPduIdRef = msg_Receive_oCAN00_2b456e3f_Rx
      MyECU_oCAN00_Tx_1ae5d671 (ComIPduGroup): ComIPduGroupHandleId=1
      msg_MyECU_Lamp_oCAN00_818e1651_Tx (ComIPdu):
        ComIPduDirection = SEND
        ComIPduType = NORMAL
        ComIPduHandleId = 0
        ComIPduSignalProcessing = DEFERRED
        ComIPduCancellationSupport = false
        ComIPduGroupRef = MyECU_oCAN00_Tx_1ae5d671
        ComIPduSignalRef = sig_LampCnt_omsg_MyECU_Lamp_oCAN00_f37e68ea_Tx
        ComPduIdRef = msg_MyECU_Lamp_oCAN00_818e1651_Tx
        ComTxIPdu: ComMinimumDelayTime=0, ComTxIPduUnusedAreasDefault=0
          ComTxModeTrue
            ComTxMode: ComTxModeMode=PERIODIC, ComTxModeTimeOffset=0, ComTxModeTimePeriod=0.1
          ComTxModeFalse
            ComTxMode: ComTxModeMode=PERIODIC, ComTxModeTimeOffset=0, ComTxModeTimePeriod=0.1
      14 x ComSignal, all with ComSignalEndianness=LITTLE_ENDIAN, ComSignalInitValue=0, ComSignalAccess=ACCESS_UNCLEAR:
        sig_RearInteriorLight_omsg_Transmit_oCAN00_49a633c1_Tx: ComBitPosition=0, ComBitSize=1, ComSignalType=BOOLEAN, ComTransferProperty=PENDING, ComHandleId=3, ComSystemTemplateSystemSignalRef=sig_RearInteriorLight
        VehicleSpeed_omsg_Receive_oCAN00_e95dd8a1_Rx: ComBitPosition=40, ComBitSize=8, ComSignalType=UINT16, ComTimeout=0, ComHandleId=10, ComSystemTemplateSystemSignalRef=VehicleSpeed
        HazardSw_omsg_Receive_oCAN00_578d9c4d_Rx: ComBitPosition=8, ComBitSize=4, ComSignalType=UINT8, ComTimeout=0, ComHandleId=2, ComSystemTemplateSystemSignalRef=HazardSw
        IGN_Status_omsg_Receive_oCAN00_593fdbd9_Rx: ComBitPosition=12, ComBitSize=4, ComSignalType=UINT8, ComTimeout=0, ComHandleId=3, ComSystemTemplateSystemSignalRef=IGN_Status
        TurnLampFb_FR_omsg_Receive_oCAN00_a2998431_Rx: ComBitPosition=20, ComBitSize=4, ComSignalType=UINT8, ComTimeout=0, ComHandleId=5, ComSystemTemplateSystemSignalRef=TurnLampFb_FR
        CrashIntensity_omsg_Receive_oCAN00_57f27485_Rx: ComBitPosition=3, ComBitSize=1, ComSignalType=BOOLEAN, ComTimeout=0, ComHandleId=0, ComSystemTemplateSystemSignalRef=CrashIntensity
        LA_St_DirectionLampL_omsg_Transmit_oCAN00_c218ca04_Tx: ComBitPosition=1, ComBitSize=4, ComSignalType=UINT8, ComTransferProperty=PENDING, ComHandleId=0, ComSystemTemplateSystemSignalRef=LA_St_DirectionLampL
        TurnLampFb_FL_omsg_Receive_oCAN00_3ab29a6d_Rx: ComBitPosition=16, ComBitSize=4, ComSignalType=UINT8, ComTimeout=0, ComHandleId=4, ComSystemTemplateSystemSignalRef=TurnLampFb_FL
        TurnLampFb_RL_omsg_Receive_oCAN00_cfe4432c_Rx: ComBitPosition=24, ComBitSize=4, ComSignalType=UINT8, ComTimeout=0, ComHandleId=6, ComSystemTemplateSystemSignalRef=TurnLampFb_RL
        LA_St_DirectionLampR_omsg_Transmit_oCAN00_a05dfcc5_Tx: ComBitPosition=8, ComBitSize=4, ComSignalType=UINT8, ComTransferProperty=PENDING, ComHandleId=1, ComSystemTemplateSystemSignalRef=LA_St_DirectionLampR
        TurnLampSw_omsg_Receive_oCAN00_92b10255_Rx: ComBitPosition=32, ComBitSize=4, ComSignalType=UINT8, ComTimeout=0, ComHandleId=8, ComSystemTemplateSystemSignalRef=TurnLampSw
        VehicleSpeed_Valid_omsg_Receive_oCAN00_6a5f4ba3_Rx: ComBitPosition=5, ComBitSize=1, ComSignalType=UINT8, ComTimeout=0, ComHandleId=9, ComSystemTemplateSystemSignalRef=VehicleSpeed_Valid
        TurnLampFb_RR_omsg_Receive_oCAN00_57cf5d70_Rx: ComBitPosition=28, ComBitSize=4, ComSignalType=UINT8, ComTimeout=0, ComHandleId=7, ComSystemTemplateSystemSignalRef=TurnLampFb_RR
        EmergencyBrakeLight_omsg_Receive_oCAN00_5282eb8e_Rx: ComBitPosition=4, ComBitSize=1, ComSignalType=UINT8, ComTimeout=0, ComHandleId=1, ComSystemTemplateSystemSignalRef=EmergencyBrakeLight
    ComGeneral:
      ComConfigurationUseDet = true
      ComEnableSignalGroupArrayApi = false
      ComRetryFailedTransmitRequests = false
      ComSupportedIPduGroups = 2
      ComVersionInfoApi = false
      ComAdvancedIPduCallouts = true
      ComOptimizedIPduGroupHandling = false
      ComMetaDataSupport = false
      ComReceiveSignalMacroAPI = false
      ComDeferredEventCacheSupport = false
      ComMainfunctionTimingDomainSupport = false
      ComDescriptionRoutingCodeGeneration = false
      ComSafeBswChecks = false

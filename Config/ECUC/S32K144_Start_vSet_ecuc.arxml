AUTOSAR XML (schema 4-2-1)
package /ActiveEcuC
  module config vSet: implementation-config-variant=VARIANT-PRE-COMPILE, module-description=vSet_Impl
    vSetGeneral: vSetDummyStatementKind=SelfAssignment
    vSetPlatform:
      vSetCPUType = CPU32Bit
      vSetBitOrder = LSB_to_MSB
      vSetByteOrder = LITTLE_ENDIAN
      vSetSizeOfROMPointer = Size32Bit
      vSetSizeOfEnum = Size32Bit
      vSetSizeOfInt = Size32Bit
      vSetSizeOfRAMPointer = Size32Bit
    vSetCalibration

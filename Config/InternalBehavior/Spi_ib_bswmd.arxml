AUTOSAR XML (schema 4-2-1)
package /TS_T40D2M10I1R0/Spi_ib_bswmd/BswModuleDescriptions
  bsw module description Spi: provided-entrys=Spi_MainFunction_Handling
    bsw internal behavior SpiBehavior
      31 x exclusive area:
        SPI_EXCLUSIVE_AREA_{00..30}
      bsw schedulable entity Spi_MainFunction_Handling: implemented-entry=Spi_MainFunction_Handling
      bsw timing event Spi_MainFunction_HandlingTimingEvent0: starts-on-event=Spi_MainFunction_Handling, period=0.005
  bsw module entry Spi_MainFunction_Handling: call-type=SCHEDULED, execution-context=TASK

AUTOSAR XML (schema 00044)
package /COM/VECTOR/CFG/WORKFLOW/SYSDESC/SYNC
  system SYSTEM: category=ECU_EXTRACT
    system mapping MAPPINGS
      data-mappings:
        data-element=TurnLight.COMPOSITIONTYPE.EmergencyBrakeLight.u8_Signal, system-signal=EmergencyBrakeLight
        data-element=TurnLight.COMPOSITIONTYPE.HazardSw.u8_Signal, system-signal=HazardSw
        data-element=TurnLight.COMPOSITIONTYPE.IGN_Status.u8_signal, system-signal=IGN_Status
        data-element=TurnLightAct.COMPOSITIONTYPE.Com_CAN_LA_St_DirectionLampL.u8_signal, system-signal=LA_St_DirectionLampL
        data-element=TurnLightAct.COMPOSITIONTYPE.Com_CAN_LA_St_DirectionLampR.u8_signal, system-signal=LA_St_DirectionLampR
        data-element=TurnLight.COMPOSITIONTYPE.TurnLampFb_FL.u8_Signal, system-signal=TurnLampFb_FL
        data-element=TurnLight.COMPOSITIONTYPE.TurnLampFb_FR.u8_Signal, system-signal=TurnLampFb_FR
        data-element=TurnLight.COMPOSITIONTYPE.TurnLampFb_RL.u8_Signal, system-signal=TurnLampFb_RL
        data-element=TurnLight.COMPOSITIONTYPE.TurnLampFb_RR.u8_Signal, system-signal=TurnLampFb_RR
        data-element=TurnLight.COMPOSITIONTYPE.TurnLampSw.u8_Signal, system-signal=TurnLampSw
        data-element=TurnLight.COMPOSITIONTYPE.VehicleSpeed.u16_signal, system-signal=VehicleSpeed
        data-element=TurnLight.COMPOSITIONTYPE.VehicleSpeed_Valid.u8_Signal, system-signal=VehicleSpeed_Valid
    root-software-compositions:
      root sw composition prototype COMPOSITIONTYPE: flat-map=FLATMAP, software-composition=COMPOSITIONTYPE
  composition sw component type COMPOSITIONTYPE  # UB:Derived from original system description
    14 x component:
      BswM: type=BswM
      ComM: type=ComM
      Det: type=Det
      EcuM: type=EcuM
      Os_OsCore0_swc: type=Os_OsCore0_swc
      DemMaster_0: type=DemMaster_0
      DemSatellite_0: type=DemSatellite_0
      Dcm: type=Dcm
      CpLedTask: type=CtLedTask
      Cdd_SBC_UJA1169: type=CddSbc
      TurnLight: type=TurnLight
      TurnLightArb: type=TurnLightArb
      TurnLightAct: type=TurnLightAct
      CddIoHwAb: type=Cdd_IoHwAb
    connect BswM.Switch_ESH_ModeSwitch -> BswM.Notification_ESH_ModeNotification
    connect ComM.UR_CN_CAN00_06ecbb07 -> CpLedTask.UR_CN_CAN00_06ecbb07
    connect TurnLightAct.TurnLampCtrlCmd_FR -> TurnLight.TurnLampCtrlCmd_FR  # UB:Derived from original system description
    connect TurnLightAct.TurnLampCtrlCmd_RR -> TurnLight.TurnLampCtrlCmd_RR  # UB:Derived from original system description
    connect TurnLightAct.CountSignal_Left -> TurnLight.CountSignal_Left  # UB:Derived from original system description
    connect TurnLightAct.TurnLampCtrlCmd_FL -> TurnLight.TurnLampCtrlCmd_FL  # UB:Derived from original system description
    connect TurnLightArb.TurnLightService -> TurnLight.TurnLightService  # UB:Derived from original system description
    connect TurnLightArb.TurnLamp_RL_Out -> TurnLightAct.TurnLamp_RL_Out  # UB:Derived from original system description
    connect TurnLightArb.TurnLapme_RR_Out -> TurnLightAct.TurnLapme_RR_Out  # UB:Derived from original system description
    connect TurnLightArb.TurnLamp_FL_Out -> TurnLightAct.TurnLamp_FL_Out  # UB:Derived from original system description
    connect TurnLightArb.TurnLapm_FR_Out -> TurnLightAct.TurnLapm_FR_Out  # UB:Derived from original system description
    connect TurnLightAct.TurnLampCtrlCmd_RL -> TurnLight.TurnLampCtrlCmd_RL  # UB:Derived from original system description
    connect TurnLightAct.CountSignal_Right -> TurnLight.CountSignal_Right  # UB:Derived from original system description
    connect CddIoHwAb.IoHwAb_TurnLightCtrlCmd_RR -> TurnLightAct.IoHwAb_TurnLightCtrlCmd_RR  # UB:Derived from original system description
    connect CddIoHwAb.IoHwAb_TurnLightCtrlCmd_FL -> TurnLightAct.IoHwAb_TurnLightCtrlCmd_FL  # UB:Derived from original system description
    connect CddIoHwAb.IoHwAb_TurnLightCtrlCmd_FR -> TurnLightAct.IoHwAb_TurnLightCtrlCmd_FR  # UB:Derived from original system description
    connect CddIoHwAb.IoHwAb_TurnLightCtrlCmd_RL -> TurnLightAct.IoHwAb_TurnLightCtrlCmd_RL  # UB:Derived from original system description
  end to end protection set E2EPROTECTIONSET
  port interface mapping set PORTINTERFACEMAPPINGSET

AUTOSAR XML (schema 4-2-1)
package /COM/VECTOR/CFG/WORKFLOW/SYSDESC/SYNC
  flat map FLATMAP
    6 x flat instance descriptor:
      CpLedTask: upstream-reference=EcuSwComposition.CpLedTask, ecu-extract-reference=COMPOSITIONTYPE.CpLedTask
      Cdd_SBC_UJA1169: upstream-reference=EcuSwComposition.Cdd_SBC_UJA1169, ecu-extract-reference=COMPOSITIONTYPE.Cdd_SBC_UJA1169
      TurnLight: upstream-reference=EcuSwComposition.TurnLight, ecu-extract-reference=COMPOSITIONTYPE.TurnLight
      TurnLightArb: upstream-reference=EcuSwComposition.TurnLightArb, ecu-extract-reference=COMPOSITIONTYPE.TurnLightArb
      TurnLightAct: upstream-reference=EcuSwComposition.TurnLightAct, ecu-extract-reference=COMPOSITIONTYPE.TurnLightAct
      CddIoHwAb: upstream-reference=EcuSwComposition.CddIoHwAb, ecu-extract-reference=COMPOSITIONTYPE.CddIoHwAb

AUTOSAR XML (schema 4-0-3)
package /AUTOSAR_Lin/BswModuleDescriptions
  bsw module description Lin: module-id=82
    provided-entrys:
      Lin_CheckWakeup
      Lin_GetStatus
      Lin_GetVersionInfo
      Lin_GoToSleep
      Lin_GoToSleepInternal
      Lin_Init
      Lin_SendFrame
      Lin_SetClockMode
      Lin_Wakeup
      Lin_WakeupInternal
      Lin_LPUART_Isr_LPUART_{0..3}
      Lin_LPUART_IsrError_LPUART_{0..3}
      Lin_LPUART_IsrTxRx_LPUART_{0..3}
    bsw internal behavior InternalBehavior_0
      26 x exclusive area:
        LIN_EXCLUSIVE_AREA_{00..25}
      10 x bsw called entity:
        Lin_CheckWakeup: implemented-entry=Lin_CheckWakeup
        Lin_GetStatus: implemented-entry=Lin_GetStatus
        Lin_GetVersionInfo: implemented-entry=Lin_GetVersionInfo
        Lin_GoToSleep: implemented-entry=Lin_GoToSleep
        Lin_GoToSleepInternal: implemented-entry=Lin_GoToSleepInternal
        Lin_Init: can-enter-exclusive-area=[LIN_EXCLUSIVE_AREA_00, LIN_EXCLUSIVE_AREA_01, LIN_EXCLUSIVE_AREA_02, LIN_EXCLUSIVE_AREA_03, LIN_EXCLUSIVE_AREA_04, LIN_EXCLUSIVE_AREA_05, LIN_EXCLUSIVE_AREA_06, LIN_EXCLUSIVE_AREA_07, LIN_EXCLUSIVE_AREA_08, LIN_EXCLUSIVE_AREA_09, LIN_EXCLUSIVE_AREA_10, LIN_EXCLUSIVE_AREA_11, LIN_EXCLUSIVE_AREA_12, LIN_EXCLUSIVE_AREA_13, LIN_EXCLUSIVE_AREA_14, LIN_EXCLUSIVE_AREA_15, LIN_EXCLUSIVE_AREA_16, LIN_EXCLUSIVE_AREA_17, LIN_EXCLUSIVE_AREA_18, LIN_EXCLUSIVE_AREA_19, LIN_EXCLUSIVE_AREA_20, LIN_EXCLUSIVE_AREA_21, LIN_EXCLUSIVE_AREA_22, LIN_EXCLUSIVE_AREA_23, LIN_EXCLUSIVE_AREA_24, LIN_EXCLUSIVE_AREA_25], implemented-entry=Lin_Init
        Lin_SendFrame: implemented-entry=Lin_SendFrame
        Lin_SetClockMode: implemented-entry=Lin_SetClockMode
        Lin_Wakeup: implemented-entry=Lin_Wakeup
        Lin_WakeupInternal: implemented-entry=Lin_WakeupInternal
      12 x bsw interrupt entity, all with interrupt-category=CAT-2, interrupt-source=Hardware:
        Lin_LPUART_Isr_LPUART_{0..3}: implemented-entry=Lin_LPUART_Isr_LPUART_{0..3}
        Lin_LPUART_IsrError_LPUART_{0..3}: implemented-entry=Lin_LPUART_IsrError_LPUART_{0..3}
        Lin_LPUART_IsrTxRx_LPUART_{0..3}: implemented-entry=Lin_LPUART_IsrTxRx_LPUART_{0..3}
package /AUTOSAR_Lin/BswModuleEntrys
  22 x bsw module entry, all with is-reentrant=false, sw-service-impl-policy=STANDARD:
    Lin_CheckWakeup: service-id=0x0a, is-synchronous=true, call-type=REGULAR, execution-context=UNSPECIFIED
    Lin_GetStatus: service-id=0x08, is-synchronous=true, call-type=REGULAR, execution-context=UNSPECIFIED
    Lin_GetVersionInfo: service-id=0x01, is-synchronous=true, call-type=REGULAR, execution-context=UNSPECIFIED
    Lin_GoToSleep: service-id=0, is-synchronous=true, call-type=REGULAR, execution-context=UNSPECIFIED
    Lin_GoToSleepInternal: service-id=0, is-synchronous=true, call-type=REGULAR, execution-context=UNSPECIFIED
    Lin_Init: service-id=0x00, is-synchronous=true, call-type=REGULAR, execution-context=UNSPECIFIED
    Lin_SendFrame: service-id=0x04, is-synchronous=false, call-type=REGULAR, execution-context=UNSPECIFIED
    Lin_SetClockMode: service-id=0, is-synchronous=true, call-type=REGULAR, execution-context=UNSPECIFIED
    Lin_Wakeup: service-id=0x07, is-synchronous=false, call-type=REGULAR, execution-context=UNSPECIFIED
    Lin_WakeupInternal: service-id=0, is-synchronous=true, call-type=REGULAR, execution-context=UNSPECIFIED
    Lin_LPUART_Isr_LPUART_{0..3}: service-id=0, is-synchronous=true, call-type=INTERRUPT, execution-context=INTERRUPT-CAT-2
    Lin_LPUART_IsrError_LPUART_{0..3}: service-id=0, is-synchronous=true, call-type=INTERRUPT, execution-context=INTERRUPT-CAT-2
    Lin_LPUART_IsrTxRx_LPUART_{0..3}: service-id=0, is-synchronous=true, call-type=INTERRUPT, execution-context=INTERRUPT-CAT-2
package /Lin_T40D2M10I1R0/Implementations
  bsw implementation BswImplementation_0: programming-language=C, sw-version=4.2.2, vendor-id=43, ar-release-version=4.2.2, behavior=InternalBehavior_0, vendor-specific-module-def=Lin
    code-descriptors:
      code Files
        artifact-descriptors:
          short-label=config::Lin.xdm, category=SWCFG
          short-label=doc::AUTOSAR_MCAL_LIN_IM.pdf, category=SWDOC
          short-label=doc::AUTOSAR_MCAL_LIN_UM.pdf, category=SWDOC
          short-label=include::Lin.h, category=SWHDR
          short-label=include::Lin_IPW.h, category=SWHDR
          short-label=include::Lin_LPUART.h, category=SWHDR
          short-label=include::Lin_NonASR.h, category=SWHDR
          short-label=include::Reg_eSys_LPUART.h, category=SWHDR
          short-label=src::Lin.c, category=SWSRC
          short-label=src::Lin_IPW.c, category=SWSRC
          short-label=src::Lin_LPUART.c, category=SWSRC
          short-label=src::Lin_LPUART_Irq.c, category=SWSRC
          short-label=src::Lin_NonASR.c, category=SWSRC
    compiler IAR_Compiler: name=IAR Compiler, options=--cpu=Cortex-M4 --cpu=Cortex-M0+ --cpu_mode=thumb --endian=little -Ohz -c --no_clustering --no_mem_idioms --no_explicit_zero_opt --debug --diag_suppress=Pa050 -DAUTOSAR_OS_NOT_USED -DIAR --require_prototypes --no_wrap_diagnostics --no_system_include -e, vendor=IAR Systems, version=IAR: V8.11.2
    compiler GHS_Compiler:
      name=Green Hills
      options=-cpu=cortexm4 -cpu=cortexm0plus -ansi -Osize -dual_debug -G --no_exceptions -Wundef -Wimplicit-int -Wshadow -Wtrigraphs -Wall --prototype_errors --incorrect_pragma_warnings -noslashcomment -preprocess_assembly_files -nostartfile --short_enum -c --no_commons -keeptempfiles -list -DAUTOSAR_OS_NOT_USED -DDISABLE_MCAL_INTERMODULE_ASR_CHECK -DGHS
      vendor=Green Hills
      version=Green Hills Multi 7.1.4 / Compiler 2017.1.4
    compiler LINARO_Compiler:
      name=Linaro Compiler
      options=-c -O1 -ggdb3 -mcpu=cortex-m4 -mthumb -mlittle-endian -fomit-frame-pointer -mhard-float -fno-common -Wall -Wextra -Wstrict-prototypes -Wno-sign-compare -DAUTOSAR_OS_NOT_USED -DLINARO -fstack-usage -fdump-ipa-all -Werror=implicit-function-declaration
      vendor=Linaro
      version=(Linaro GCC 6.3-2017.06~dev) 6.3.1 20170509 (Thu Dec 7 13:28:42 CST 2017 build.sh rev=g7fea41d s=L631 Earmv7 -V release_g7fea41d_build_Fed_Earmv7) (from S32-DS-ARM_v2018)
    generated-artifacts:
      dependency on artifact Lin_PBcfg_c: artifact-descriptor={short-label=generate_PB::src::Lin_PBcfg.c, category=SWSRC}, usages=COMPILE
      dependency on artifact Lin_Cfg_h: artifact-descriptor={short-label=generate_PC::include::Lin_Cfg.h, category=SWHDR}, usages=COMPILE
      dependency on artifact Lin_Cfg_c: artifact-descriptor={short-label=generate_PC::src::Lin_Cfg.c, category=SWSRC}, usages=COMPILE
    linker IAR_Linker: name=IAR Compiler, options=--map filename --no_library_search --entry _start --enable_stack_usage --skip_dynamic_initialization --no_wrap_diagnostics --config, vendor=IAR Systems, version=IAR: V8.11.2
    linker GHS_Linker: name=Green Hills, options=-Mn -delete -v -ignore_debug_references -map -keepmap -lstartup -lsys -larch -lansi -L(/lib/thumb2) -lutf8_s32, vendor=Green Hills, version=Green Hills Multi 7.1.4 / Compiler 2017.1.4
    linker LINARO_Linker: name=Linaro Compiler, options=-Map=filename -T scriptfile, vendor=Linaro, version=(Linaro GCC 6.3-2017.06~dev) 6.3.1 20170509 (Thu Dec 7 13:28:42 CST 2017 build.sh rev=g7fea41d s=L631 Earmv7 -V release_g7fea41d_build_Fed_Earmv7) (from S32-DS-ARM_v2018)
    resource consumption ResourceConsumption
      8 x memory section:
        LIN_CODE: alignment=UNSPECIFIED, sw-addrmethod=CODE, symbol=CODE
        LIN_CONFIG_DATA_UNSPECIFIED: alignment=UNSPECIFIED, sw-addrmethod=CONFIG_DATA_UNSPECIFIED, symbol=CONFIG_DATA_UNSPECIFIED
        LIN_CONST_32: alignment=32, sw-addrmethod=CONST_32, symbol=CONST_32
        LIN_CONST_UNSPECIFIED: alignment=UNSPECIFIED, sw-addrmethod=CONST_UNSPECIFIED, symbol=CONST_UNSPECIFIED
        LIN_VAR_INIT_8: alignment=8, sw-addrmethod=VAR_INIT_8, symbol=VAR_INIT_8
        LIN_VAR_INIT_UNSPECIFIED: alignment=UNSPECIFIED, sw-addrmethod=VAR_INIT_UNSPECIFIED, symbol=VAR_INIT_UNSPECIFIED
        LIN_VAR_NO_INIT_8: alignment=8, sw-addrmethod=VAR_NO_INIT_8, symbol=VAR_NO_INIT_8
        LIN_VAR_NO_INIT_UNSPECIFIED: alignment=UNSPECIFIED, sw-addrmethod=VAR_NO_INIT_UNSPECIFIED, symbol=VAR_NO_INIT_UNSPECIFIED
